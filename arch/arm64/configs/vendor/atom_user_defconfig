## arch/arm64/configs/vendor/atom_user_defconfig
```kconfig
CONFIG_CROSS_COMPILE="aarch64-linux-android-"
# CONFIG_FHANDLE is not set
CONFIG_IKHEADERS=m
CONFIG_UCLAMP_TASK=y
CONFIG_UCLAMP_GROUPS_COUNT=32
CONFIG_UCLAMP_MAP_OPP=y
CONFIG_NONLINEAR_FREQ_CTL=y
CONFIG_UCLAMP_TASK_GROUP=y
CONFIG_CPUSETS=y
CONFIG_SCHED_TUNE=y
CONFIG_DEFAULT_USE_ENERGY_AWARE=y
# CONFIG_RD_BZIP2 is not set
# CONFIG_RD_LZMA is not set
# CONFIG_RD_XZ is not set
# CONFIG_RD_LZO is not set
# CONFIG_RD_LZ4 is not set
CONFIG_SYSCTL_SYSCALL=y
# CONFIG_KALLSYMS_BASE_RELATIVE is not set
# CONFIG_SLUB_DEBUG is not set
CONFIG_CC_STACKPROTECTOR_STRONG=y
CONFIG_MODULE_SRCVERSION_ALL=y
# CONFIG_BLK_DEV_BSG is not set
CONFIG_BLK_INLINE_ENCRYPTION=y
CONFIG_BLK_INLINE_ENCRYPTION_FALLBACK=y
CONFIG_MACH_MT6873=y
CONFIG_SCHED_MC=y
CONFIG_NR_CPUS=8
CONFIG_PREEMPT=y
# CONFIG_BOUNCE is not set
CONFIG_ZSMALLOC=y
CONFIG_RANDOMIZE_BASE=y
CONFIG_CMDLINE="console=tty0 console=ttyMT3,921600n1 root=/dev/ram vmalloc=496M slub_max_order=0 slub_debug=O "
# CONFIG_EFI is not set
CONFIG_BUILD_ARM64_APPENDED_DTB_IMAGE=y
# CONFIG_CORE_DUMP_DEFAULT_ELF_HEADERS is not set
CONFIG_COMPAT=y
CONFIG_WQ_POWER_EFFICIENT_DEFAULT=y
CONFIG_CPU_FREQ=y
CONFIG_CPU_FREQ_STAT=y
CONFIG_CPU_FREQ_DEFAULT_GOV_SCHEDUTIL=y
CONFIG_CPU_FREQ_GOV_POWERSAVE=y
CONFIG_CPU_FREQ_GOV_USERSPACE=y
CONFIG_CPU_FREQ_GOV_ONDEMAND=y
CONFIG_XFRM_MIGRATE=y
CONFIG_SYN_COOKIES=y
CONFIG_BRIDGE=y
CONFIG_VLAN_8021Q=y
CONFIG_CLS_U32_PERF=y
CONFIG_CLS_U32_MARK=y
CONFIG_CFG80211=y
CONFIG_NL80211_TESTMODE=y
CONFIG_CFG80211_DEVELOPER_WARNINGS=y
# CONFIG_CFG80211_DEFAULT_PS is not set
CONFIG_CFG80211_INTERNAL_REGDB=y
# CONFIG_UEVENT_HELPER is not set
CONFIG_EXTRA_FIRMWARE="valhall-1691526.wa"
CONFIG_EXTRA_FIRMWARE_DIR="firmware"
CONFIG_MTD_BLOCK=y
CONFIG_ZRAM=y
CONFIG_BLK_DEV_LOOP_MIN_COUNT=16
CONFIG_MEDIATEK_SOLUTION=y
CONFIG_MTK_PLATFORM="mt6873"
CONFIG_ARCH_MTK_PROJECT="k6873v1_64"
CONFIG_MTK_GPT_SCHEME_SUPPORT=y
CONFIG_MTK_PMIC_NEW_ARCH=y
CONFIG_MTK_PMIC_COMMON=y
CONFIG_MTK_PMIC_CHIP_MT6359P=y
CONFIG_MTK_EXTERNAL_CHARGER_TYPE_DETECT=y
CONFIG_MFD_MT6360_PMU=y
CONFIG_MT6360_PMU_CHARGER=y
CONFIG_MT6360_PMU_FLED=y
CONFIG_MT6360_PMIC=y
CONFIG_MT6360_LDO=y
CONFIG_MT6360_PMU_RGBLED=y
CONFIG_MTK_APUSYS_SUPPORT=y
CONFIG_MTK_APUSYS_DEBUG=y
CONFIG_MTK_APUSYS_RT_SUPPORT=y
CONFIG_MTK_APUSYS_MDLA_SUPPORT=y
CONFIG_MTK_APUSYS_EDMA_SUPPORT=y
CONFIG_MTK_CPU_FREQ=y
CONFIG_MTK_PTPOD=y
CONFIG_MTK_PTPOD_GPU=y
CONFIG_MTK_STATIC_POWER=y
CONFIG_MTK_UNIFY_POWER=y
CONFIG_MTK_SLBC=y
CONFIG_MTK_CM_MGR=y
CONFIG_MTK_THERMAL_PA_VIA_ATCMD=y
CONFIG_MTK_SPMTWAM=y
CONFIG_CUSTOM_KERNEL_IMGSENSOR="ov48bsunny_mipi_raw ov48bofilm_mipi_raw ov16a1qsunny_mipi_raw ov16a1qofilm_mipi_raw gc02m1b_mipi_raw gc5035ofilm_mipi_raw s5k4h7sunny_mipi_raw s5k4h7ofilm_mipi_raw"
CONFIG_CUSTOM_KERNEL_CAM_CAL_DRV="BRCB032GWZ_3 GT24c32a cat24c16"
CONFIG_MTK_CAMERA_ISP_RSC_SUPPORT=y
CONFIG_MTK_CAMERA_ISP_DPE_SUPPORT=y
CONFIG_MTK_CAMERA_ISP_TSF_SUPPORT=y
CONFIG_MTK_CAMERA_ISP_FD_SUPPORT=y
CONFIG_MTK_CAMERA_ISP_WPE_SUPPORT=y
CONFIG_MTK_CAMERA_ISP_OWE_SUPPORT=y
CONFIG_MTK_CAMERA_ISP_MFB_SUPPORT=y
CONFIG_MTK_CAM_CAL=y
CONFIG_MTK_CMDQ=y
CONFIG_MTK_CMDQ_MBOX_EXT=y
CONFIG_MTK_IMGSENSOR=y
CONFIG_MTK_SMI_EXT=y
CONFIG_CUSTOM_KERNEL_LCM="s6e8fc01_fhdp_vdo"
CONFIG_MTK_LCM_PHYSICAL_ROTATION="0"
CONFIG_LCM_HEIGHT="2400"
CONFIG_MTK_AAL_SUPPORT=y
CONFIG_MTK_DRE30_SUPPORT=y
CONFIG_MTK_ROUND_CORNER_SUPPORT=y
CONFIG_MTK_DISP_GAME_PQ_SUPPORT=y
CONFIG_MTK_HDR_VIDEO_SUPPORT=y
CONFIG_MTK_PQ_COLOR_MODE="DISP"
CONFIG_MTK_CAM_SECURITY_SUPPORT=y
#CONFIG_MTK_CAM_GENIEZONE_SUPPORT=y
CONFIG_MTK_CCU=y
CONFIG_MTK_SENSOR_SUPPORT=y
CONFIG_MTK_SENSOR_ARCHITECTURE="2.0"
CONFIG_CUSTOM_KERNEL_ACCELEROMETER=y
CONFIG_MTK_ACCELHUB=y
CONFIG_CUSTOM_KERNEL_ALSPS=y
CONFIG_MTK_ALSPSHUB=y
CONFIG_CUSTOM_KERNEL_GYROSCOPE=y
CONFIG_MTK_GYROHUB=y
CONFIG_CUSTOM_KERNEL_MAGNETOMETER=y
CONFIG_MTK_MAGHUB=y
CONFIG_MTK_HWMON=y
#CONFIG_CUSTOM_KERNEL_BAROMETER is not set
CONFIG_MTK_BAROHUB=y
CONFIG_CUSTOM_KERNEL_SENSOR_FUSION=y
CONFIG_CUSTOM_KERNEL_GRV_SENSOR=y
CONFIG_CUSTOM_KERNEL_GMRV_SENSOR=y
CONFIG_CUSTOM_KERNEL_RV_SENSOR=y
CONFIG_CUSTOM_KERNEL_LINEARACCEL_SENSOR=y
CONFIG_CUSTOM_KERNEL_GRAVITY_SENSOR=y
CONFIG_CUSTOM_KERNEL_UNCALI_ACC_SENSOR=y
CONFIG_CUSTOM_KERNEL_UNCALI_GYRO_SENSOR=y
CONFIG_CUSTOM_KERNEL_UNCALI_MAG_SENSOR=y
CONFIG_CUSTOM_KERNEL_STEP_COUNTER=y
CONFIG_MTK_STEPSIGNHUB=y
CONFIG_CUSTOM_KERNEL_SITUATION=y
CONFIG_MTK_STATHUB=y
CONFIG_MTK_WAKEHUB=y
CONFIG_MTK_GLGHUB=y
CONFIG_MTK_PICKUPHUB=y
CONFIG_MTK_DEVICE_ORIENTATION_HUB=y
CONFIG_MTK_MOTION_DETECT_HUB=y
CONFIG_MTK_TILTDETECTHUB=y
CONFIG_CUSTOM_KERNEL_SENSORHUB=y
CONFIG_MTK_COMBO=y
CONFIG_MTK_COMBO_CHIP_CONSYS_6873=y
CONFIG_MTK_COMBO_BT=y
CONFIG_MTK_COMBO_GPS=y
CONFIG_MTK_COMBO_WIFI=y
CONFIG_MTK_DHCPV6C_WIFI=y
CONFIG_MTK_GPS_SUPPORT=y
CONFIG_MTK_GPS_EMI=y
CONFIG_MTK_FMRADIO=y
CONFIG_MTK_FM_CHIP="MT6635_FM"
CONFIG_MTK_CONNSYS_DEDICATED_LOG_PATH=y
CONFIG_MTK_ECCCI_DRIVER=y
CONFIG_MTK_ECCCI_C2K=y
CONFIG_MTK_BTIF=y
CONFIG_MTK_MDDP_SUPPORT=y
CONFIG_MTK_MCIF_WIFI_SUPPORT=y
CONFIG_MTK_ENABLE_GENIEZONE=y
CONFIG_MTK_GZ_SUPPORT_SDSP=y
CONFIG_MTK_ACCDET=y
CONFIG_ACCDET_EINT_IRQ=y
CONFIG_ACCDET_SUPPORT_EINT0=y
# CONFIG_MTK_M4U is not set
CONFIG_MTK_PSEUDO_M4U=y
CONFIG_MTK_LENS=y
CONFIG_MTK_FLASHLIGHT=y
CONFIG_MTK_FLASHLIGHT_MT6360=y
CONFIG_MTK_FLASHLIGHT_PT=y
CONFIG_MTK_FLASHLIGHT_PT_STRICT=y
CONFIG_MTK_FLASHLIGHT_DLPT=y
CONFIG_MTK_TINYSYS_SCP_SUPPORT=y
CONFIG_MTK_IRTX_PWM_SUPPORT=y
CONFIG_MTK_LEDS=y
CONFIG_LEDS_MTK_DISP=y
CONFIG_MTK_PWM=y
CONFIG_MTK_CHIP=y
CONFIG_MTK_IDLE_BALANCE_ENHANCEMENT=y
CONFIG_MTK_SCHED_EAS_POWER_SUPPORT=y
CONFIG_SCHED_HMP=y
CONFIG_MTK_SCHED_BOOST=y
CONFIG_MTK_SCHED_RQAVG_KS=y
CONFIG_MTK_SCHED_RQAVG_US=y
CONFIG_MTK_SCHED_CPULOAD=y
CONFIG_MTK_AURISYS_PHONE_CALL_SUPPORT=y
CONFIG_MTK_AUDIODSP_SUPPORT=y
CONFIG_MTK_RAM_CONSOLE=y
CONFIG_MTK_AEE_FEATURE=y
CONFIG_MTK_SIB_USB_SWITCH=y
CONFIG_MTK_RTC=y
CONFIG_MTK_USB_TYPEC_U3_MUX=y
CONFIG_TCPC_MT6360=y
# CONFIG_MTK_TYPEC_WATER_DETECT is not set
# CONFIG_MTK_TYPEC_WATER_DETECT_BY_PCB is not set
CONFIG_TCPC_CLASS=y
CONFIG_USB_POWER_DELIVERY=y
CONFIG_MTK_LOAD_TRACKER=y
CONFIG_MTK_CPU_CTRL_CFP=y
CONFIG_MTK_PERF_OBSERVER=y
CONFIG_MTK_RESYM=y
CONFIG_MTK_FPSGO_V3=y
CONFIG_MTK_EARA_THERMAL=y
CONFIG_MTK_GBE=y
CONFIG_MTK_PERF_TRACKER=y
CONFIG_MTK_LOWMEM_HINT=y
CONFIG_MTK_SKB_OWNER=y
CONFIG_MTK_TASK_TURBO=y
CONFIG_MTPROF=y
CONFIG_ANDROID_DEFAULT_SETTING=y
CONFIG_MTK_ANDROID_DEFAULT_SETTING=y
CONFIG_MTK_TIMER_TIMESYNC=y
CONFIG_MTK_FREQ_HOPPING=y
CONFIG_MTK_TINYSYS_SSPM_SUPPORT=y
CONFIG_MTK_GPU_SUPPORT=y
CONFIG_MTK_GPU_VERSION="mali valhall r32p1"
CONFIG_MTK_GPU_COMMON_DVFS_SUPPORT=y
CONFIG_MTK_GPU_SWPM_SUPPORT=y
CONFIG_AW8624_XM_HAPTIC=y
CONFIG_MTK_SYNC=y
CONFIG_MTK_VPU_SUPPORT=y
CONFIG_MTK_VPU_SUPPORT_DEBUG=y
CONFIG_MTK_VOW_SUPPORT=y
CONFIG_MTK_VOW_DUAL_MIC_SUPPORT=y
CONFIG_MTK_VOW_MAX_PDK_NUMBER=1
CONFIG_MTK_VOW_AMAZON_SUPPORT=n
CONFIG_MTK_VOW_GVA_SUPPORT=n
CONFIG_MTK_DRAM_LOG_STORE=y
CONFIG_MTK_DRAM_LOG_STORE_ADDR=0x0011DF00
CONFIG_MTK_DRAM_LOG_STORE_SIZE=0x100
CONFIG_MTK_TINYSYS_MCUPM_SUPPORT=y
CONFIG_SCSI=y
CONFIG_BLK_DEV_SD=y
CONFIG_SCSI_SCAN_ASYNC=y
CONFIG_SCSI_UFSHCD=y
CONFIG_SCSI_UFSHCD_PLATFORM=y
CONFIG_MTK_UFS_SUPPORT=y
CONFIG_UFSFEATURE=y
CONFIG_UFSHPB=y
CONFIG_UFSTW=y
CONFIG_UFSTW_IGNORE_GUARANTEE_BIT=y
CONFIG_SCSI_SKHPB=y
CONFIG_SCSI_UFS_CRYPTO=y
CONFIG_BLK_DEV_DM=y
CONFIG_DM_CRYPT=y
CONFIG_DM_DEFAULT_KEY=y
CONFIG_DM_UEVENT=y
CONFIG_DM_VERITY_FEC=y
CONFIG_IFB=y
# CONFIG_ETHERNET is not set
CONFIG_PPP_FILTER=y
CONFIG_PPP_MULTILINK=y
CONFIG_PPPOE=y
CONFIG_PPP_ASYNC=y
CONFIG_PPP_SYNC_TTY=y
# CONFIG_KEYBOARD_ATKBD is not set
CONFIG_KEYBOARD_MTK=y
CONFIG_ONEKEY_REBOOT_NORMAL_MODE=y
CONFIG_ONEKEY_REBOOT_OTHER_MODE=y
CONFIG_KPD_PWRKEY_USE_PMIC=y
# CONFIG_INPUT_MOUSE is not set
CONFIG_INPUT_TOUCHSCREEN=y
CONFIG_TOUCHSCREEN_MTK_TOUCH="GT9896S GT9886"
CONFIG_INPUT_MISC=y
CONFIG_INPUT_UINPUT=y
CONFIG_INPUT_JOYSTICK=y
CONFIG_JOYSTICK_XPAD=y
CONFIG_JOYSTICK_XPAD_FF=y
CONFIG_JOYSTICK_XPAD_LEDS=y
CONFIG_TOUCHSCREEN_FTS=y
CONFIG_TOUCHSCREEN_FTS_FOD=y
CONFIG_I2C_STATUS_FOR_TOUCH=y
CONFIG_LAST_TOUCH_EVENTS=y
CONFIG_TOUCHSCREEN_XIAOMI_TOUCHFEATURE=y
# CONFIG_VT is not set
CONFIG_LEGACY_PTY_COUNT=16
# CONFIG_DEVMEM is not set
CONFIG_SERIAL_8250=y
CONFIG_SERIAL_8250_CONSOLE=y
CONFIG_SERIAL_8250_NR_UARTS=2
CONFIG_SERIAL_8250_RUNTIME_UARTS=2
CONFIG_SERIAL_8250_MT6577=y
CONFIG_I2C_MTK=y
CONFIG_SPI=y
CONFIG_SPI_MT65XX=y
CONFIG_SPMI=y
CONFIG_MTK_PMIF=y
CONFIG_MTK_GAUGE_VERSION=30
CONFIG_MTK_CHARGER=y
CONFIG_MTK_KERNEL_POWER_OFF_CHARGING=y
# CONFIG_MTK_CHARGER_BEGONIA is not set
CONFIG_MTK_CHARGER_BOMB=y
# CONFIG_MTK_CHARGER_CEZANNE is not set
# CONFIG_MTK_CHARGER_CANNON is not set
# CONFIG_HWMON is not set
CONFIG_THERMAL=y
CONFIG_CPU_THERMAL=y
CONFIG_THERMAL_DEFAULT_GOV_BACKWARD_COMPATIBLE=y
CONFIG_WATCHDOG=y
CONFIG_MTK_WATCHDOG_COMMON=y
CONFIG_MTK_WATCHDOG_COMMON_V2=y
CONFIG_MFD_MT6358=y
CONFIG_MT6358_MISC=y
CONFIG_MTK_MFD_SPMI_PMIC=y
CONFIG_REGULATOR=y
CONFIG_REGULATOR_MT6315=y
CONFIG_REGULATOR_MT6359P=y
CONFIG_MEDIA_SUPPORT=y
CONFIG_MEDIA_CAMERA_SUPPORT=y
CONFIG_V4L_PLATFORM_DRIVERS=y
CONFIG_V4L_MEM2MEM_DRIVERS=y
CONFIG_VIDEO_MEDIATEK_JPEG=y
CONFIG_VIDEO_MEDIATEK_VCU_WO_FUSE=y
CONFIG_VIDEO_MEDIATEK_VCODEC=y
CONFIG_DRM=y
CONFIG_DRM_PANEL_SAMSUNG_S6E8FC01=y
CONFIG_DRM_MEDIATEK=y
CONFIG_DRM_MEDIATEK_BOMB=y
# CONFIG_DRM_MEDIATEK_CANNON is not set
CONFIG_FB_MODE_HELPERS=y
CONFIG_FB_TILEBLITTING=y
CONFIG_BACKLIGHT_LCD_SUPPORT=y
CONFIG_BACKLIGHT_CLASS_DEVICE=y
CONFIG_LOGO=y
CONFIG_SND_HRTIMER=y
CONFIG_SND_DYNAMIC_MINORS=y
CONFIG_SND_VERBOSE_PRINTK=y
CONFIG_SND_DEBUG=y
CONFIG_SND_DEBUG_VERBOSE=y
CONFIG_SND_PCM_XRUN_DEBUG=y
CONFIG_SND_SEQUENCER=y
CONFIG_SND_SEQ_DUMMY=y
# CONFIG_SND_SPI is not set
CONFIG_SND_USB_AUDIO=y
CONFIG_MTK_UAC_POWER_SAVING=y
CONFIG_SND_SOC=y
CONFIG_SND_SOC_MT6873_MT6359=y
CONFIG_SND_SOC_MTK_BTCVSD=y
CONFIG_MTK_VOW_BARGE_IN_SUPPORT=y
CONFIG_SND_SOC_MTK_AUDIO_DSP=y
CONFIG_SND_SOC_CS35L41=y
CONFIG_SND_SOC_CS35L41_I2C=y
CONFIG_SND_SOC_WM_ADSP=y
CONFIG_HIDRAW=y
CONFIG_HID_A4TECH=y
CONFIG_HID_APPLE=y
CONFIG_HID_BELKIN=y
CONFIG_HID_CHERRY=y
CONFIG_HID_CHICONY=y
CONFIG_HID_CYPRESS=y
CONFIG_HID_DRAGONRISE=y
CONFIG_HID_EZKEY=y
CONFIG_HID_KYE=y
CONFIG_HID_GYRATION=y
CONFIG_HID_TWINHAN=y
CONFIG_HID_KENSINGTON=y
CONFIG_HID_LOGITECH=y
CONFIG_HID_MAGICMOUSE=y
CONFIG_HID_MICROSOFT=y
CONFIG_HID_MONTEREY=y
CONFIG_HID_PANTHERLORD=y
CONFIG_HID_PETALYNX=y
CONFIG_HID_SAMSUNG=y
CONFIG_HID_SUNPLUS=y
CONFIG_HID_GREENASIA=y
CONFIG_HID_SMARTJOYPLUS=y
CONFIG_HID_TOPSEED=y
CONFIG_HID_THRUSTMASTER=y
CONFIG_HID_ZEROPLUS=y
CONFIG_USB_XHCI_HCD=y
CONFIG_USB_XHCI_MTK_SUSPEND=y
CONFIG_USB_STORAGE=y
CONFIG_USB_STORAGE_DATAFAB=y
CONFIG_USB_STORAGE_FREECOM=y
CONFIG_USB_STORAGE_ISD200=y
CONFIG_USB_STORAGE_USBAT=y
CONFIG_USB_STORAGE_SDDR09=y
CONFIG_USB_STORAGE_SDDR55=y
CONFIG_USB_STORAGE_JUMPSHOT=y
CONFIG_USB_STORAGE_ALAUDA=y
CONFIG_USB_STORAGE_ONETOUCH=y
CONFIG_USB_STORAGE_KARMA=y
CONFIG_USB_STORAGE_CYPRESS_ATACB=y
CONFIG_USB_MTU3=y
CONFIG_USB_MTU3_PLAT_PHONE=y
CONFIG_USB_TRANCEVIBRATOR=y
CONFIG_NOP_USB_XCEIV=y
CONFIG_DUAL_ROLE_USB_INTF=y
CONFIG_USB_GADGET_VBUS_DRAW=500
CONFIG_USB_CONFIGFS_SERIAL=y
CONFIG_USB_CONFIGFS_ACM=y
CONFIG_USB_CONFIGFS_RNDIS=y
CONFIG_USB_CONFIGFS_MASS_STORAGE=y
CONFIG_USB_CONFIGFS_F_HID=y
CONFIG_MMC=y
CONFIG_MMC_BLOCK_MINORS=32
CONFIG_MMC_CRYPTO=y
CONFIG_MMC_MTK_PRO=y
CONFIG_MTK_EMMC_SUPPORT=y
CONFIG_MTK_EMMC_CACHE=y
CONFIG_MTK_EMMC_SUPPORT_OTP=y
CONFIG_MTK_EMMC_HW_CQ=y
CONFIG_NEW_LEDS=y
CONFIG_LEDS_CLASS=y
CONFIG_LEDS_PWM=y
CONFIG_LEDS_TRIGGERS=y
CONFIG_LEDS_TRIGGER_TIMER=y
# CONFIG_RTC_SYSTOHC is not set
CONFIG_RTC_DRV_MT6358=y
CONFIG_DMADEVICES=y
CONFIG_DMA_MTK_UART=y
CONFIG_ANDROID_INTF_ALARM_DEV=y
CONFIG_ION=y
CONFIG_MTK_ION=y
CONFIG_NANOHUB=y
CONFIG_NANOHUB_MTK_IPI=y
CONFIG_MAILBOX=y
CONFIG_MTK_CMDQ_MBOX=y
CONFIG_MTK_RPMSG_MBOX=y
CONFIG_MTK_IOMMU_V2=y
CONFIG_MTK_IOMMU_PGTABLE_EXT=34
CONFIG_RPMSG_MTK=y
CONFIG_MTK_PMIC_WRAP=y
CONFIG_MTK_IPI=y
CONFIG_MTK_MBOX=y
CONFIG_EXTCON_MTK_USB=y
CONFIG_MEDIATEK_MC=y
CONFIG_IIO=y
CONFIG_IIO_BUFFER=y
CONFIG_IIO_KFIFO_BUF=y
CONFIG_MEDIATEK_MT6577_AUXADC=y
CONFIG_MT635X_AUXADC=y
CONFIG_PWM=y
CONFIG_PWM_MTK_DISP=y
CONFIG_PHY_MTK_USB=y
CONFIG_FS_ENCRYPTION_INLINE_CRYPT=y
CONFIG_QUOTA_NETLINK_INTERFACE=y
CONFIG_INCREMENTAL_FS=y
CONFIG_ISO9660_FS=y
CONFIG_JOLIET=y
CONFIG_ZISOFS=y
CONFIG_MSDOS_FS=y
CONFIG_VFAT_FS=y
CONFIG_TMPFS=y
CONFIG_SDCARD_FS=y
CONFIG_PSTORE=y
CONFIG_PSTORE_CONSOLE=y
CONFIG_PSTORE_PMSG=y
CONFIG_PSTORE_RAM=y
# CONFIG_NETWORK_FILESYSTEMS is not set
CONFIG_NLS_CODEPAGE_437=y
CONFIG_NLS_CODEPAGE_950=y
CONFIG_NLS_ASCII=y
CONFIG_NLS_ISO8859_1=y
CONFIG_NLS_UTF8=y
CONFIG_PRINTK_TIME=y
CONFIG_DYNAMIC_DEBUG=y
CONFIG_DEBUG_INFO=y
CONFIG_FRAME_WARN=3600
CONFIG_PANIC_ON_OOPS=y
CONFIG_PANIC_TIMEOUT=1
CONFIG_SCHEDSTATS=y
# CONFIG_DEBUG_PREEMPT is not set
# CONFIG_DEBUG_BUGVERBOSE is not set
CONFIG_RCU_CPU_STALL_TIMEOUT=10
CONFIG_FAULT_INJECTION=y
CONFIG_ENABLE_DEFAULT_TRACERS=y
CONFIG_MTK_SCHED_TRACERS=y
CONFIG_STATIC_USERMODEHELPER_PATH="/system_ext/bin/aee_core_forwarder"
CONFIG_SECURITY_SELINUX_BOOTPARAM=y
CONFIG_SECURITY_SELINUX_DEVELOP=y
CONFIG_CRYPTO_TWOFISH=y
CONFIG_SIMTRAY_STATUS=y
CONFIG_TASK_DELAY_ACCT=y
# CONFIG_CRYPTO_HW is not set
CONFIG_CRC8=y
CONFIG_REGULATOR_FAN53870=y
CONFIG_MTK_TEE_GP_SUPPORT=y
CONFIG_MTK_SEC_VIDEO_PATH_SUPPORT=y
CONFIG_MICROTRUST_TEE_SUPPORT=y
CONFIG_BQ2597X_CHARGE_PUMP=y
CONFIG_BATT_VERIFY=y
CONFIG_ONEWIRE_GPIO=y
CONFIG_BATT_VERIFY_BY_DS28E16=y
CONFIG_XMUSB350_DET_CHG=y
CONFIG_OF=y
CONFIG_MTK_FINGERPRINT_SUPPORT=y
CONFIG_GOODIX_FINGERPRINT=y
# CONFIG_GOODIX_CAP_FINGERPRINT is not set
CONFIG_NFC=n
CONFIG_MTK_NFC_CLKBUF_ENABLE=n
CONFIG_NFC_PN553_DEVICES=n
CONFIG_NXP_P73_DEVICES=n
CONFIG_NETFILTER_XT_MATCH_MULTIPORT=y
CONFIG_BLK_WBT_SQ=y
CONFIG_BLK_WBT_MQ=n
CONFIG_WLAN_DRV_BUILD_IN=y

CONFIG_KPROBES=y
CONFIG_HAVE_KPROBES=y
CONFIG_KPROBE_EVENTS=y

# =========================================================
# 以下为 2026-11-07 同步块（来源：bomb_user_defconfig 功能项 +
# atom 官核 config 对齐项），按类别分组摆放
# =========================================================

# ---- KernelSU / susfs ----
# CONFIG_KSU_SUSFS is not set
# CONFIG_KSU_SUSFS_ENABLE_LOG is not set
# CONFIG_KSU_SUSFS_HIDE_KSU_SUSFS_SYMBOLS is not set
# CONFIG_KSU_SUSFS_OPEN_REDIRECT is not set
# CONFIG_KSU_SUSFS_SPOOF_CMDLINE_OR_BOOTCONFIG is not set
# CONFIG_KSU_SUSFS_SPOOF_UNAME is not set
# CONFIG_KSU_SUSFS_SUS_KSTAT is not set
# CONFIG_KSU_SUSFS_SUS_MAP is not set
# CONFIG_KSU_SUSFS_SUS_MOUNT is not set
# CONFIG_KSU_SUSFS_SUS_PATH is not set
CONFIG_KSU=y

# ---- BPF / XDP ----
# CONFIG_BPF_UNPRIV_DEFAULT_OFF is not set
CONFIG_ARCH_WANT_DEFAULT_BPF_JIT=y
CONFIG_BPF=y
CONFIG_BPF_EVENTS=y
CONFIG_BPF_JIT=y
CONFIG_BPF_JIT_ALWAYS_ON=y
CONFIG_BPF_JIT_DEFAULT_ON=y
CONFIG_BPF_SYSCALL=y
CONFIG_CGROUP_BPF=y
CONFIG_HAVE_EBPF_JIT=y
CONFIG_NETFILTER_XT_MATCH_BPF=y
CONFIG_NET_CLS_BPF=y
CONFIG_XDP_SOCKETS=y

# ---- EROFS ----
CONFIG_EROFS_FS=y
CONFIG_EROFS_FS_POSIX_ACL=y
CONFIG_EROFS_FS_SECURITY=y
CONFIG_EROFS_FS_XATTR=y
CONFIG_EROFS_FS_ZIP=y

# ---- cgroup / 调度 / IO ----
CONFIG_BFQ_GROUP_IOSCHED=y
CONFIG_BLK_DEV_THROTTLING=y
CONFIG_CFQ_GROUP_IOSCHED=y
CONFIG_CGROUPS=y
CONFIG_CGROUP_FREEZER=y
CONFIG_CGROUP_WRITEBACK=y
CONFIG_MILLET_CGROUP=y
CONFIG_PSI=y
# CONFIG_BLK_CGROUP is not set
# CONFIG_BLK_WBT is not set
# CONFIG_CFS_BANDWIDTH is not set
# CONFIG_CGROUP_DEVICE is not set
# CONFIG_CGROUP_NET_PRIO is not set
# CONFIG_CGROUP_PIDS is not set
# CONFIG_IOSCHED_BFQ is not set

# ---- Droidspaces（命名空间/tmpfs/网络） ----
CONFIG_IP6_NF_TARGET_MASQUERADE=y
CONFIG_IPC_NS=y
CONFIG_NF_CONNTRACK_PROCFS=y
CONFIG_UNICODE=y
CONFIG_BRIDGE_NETFILTER=m
# CONFIG_DEVTMPFS is not set
# CONFIG_IP6_NF_NAT is not set
# CONFIG_MACVLAN is not set
# CONFIG_NETFILTER_XT_MATCH_ADDRTYPE is not set
# CONFIG_NF_NAT_IPV6 is not set
# CONFIG_NF_TABLES is not set
# CONFIG_POSIX_MQUEUE is not set
# CONFIG_SYSVIPC is not set
# CONFIG_TMPFS_POSIX_ACL is not set
# CONFIG_TMPFS_XATTR is not set
# CONFIG_USER_NS is not set

# ---- MILLET（小米冻结） ----
CONFIG_MILLET=y
CONFIG_MILLET_BINDER=y
CONFIG_MILLET_PKG=y
CONFIG_MILLET_SIG=y

# ---- MIUI 通用 ----
CONFIG_MI_MEMORY_SYSFS=y
CONFIG_MTBF_SUPPORT=y
CONFIG_MTK_SOCINFO=y
CONFIG_MIGT=y
CONFIG_MIHW=y
CONFIG_MIUI_ZRAM_MEMORY_TRACKING=y
# CONFIG_XLOGCHAR is not set

# ---- 加密 / 压缩 ----
CONFIG_CRYPTO_CHACHA20=y
CONFIG_CRYPTO_CHACHA20POLY1305=y
CONFIG_CRYPTO_POLY1305=y
CONFIG_CRYPTO_ZSTDN=y
CONFIG_MMC_CRYPTO_LEGACY=y
CONFIG_ZRAM_WRITEBACK=y

# ---- 网络 / USB ----
CONFIG_FIXED_PHY=y
CONFIG_FUSE_FS=y
CONFIG_MDIO_BUS=y
CONFIG_MDIO_DEVICE=y
CONFIG_OF_MDIO=y
CONFIG_PHYLIB=y
CONFIG_SOC_BUS=y
CONFIG_SWPHY=y
CONFIG_USB_ARMLINUX=y
CONFIG_USB_BELKIN=y
CONFIG_USB_NET_AX88179_178A=y
CONFIG_USB_NET_AX8817X=y
CONFIG_USB_NET_CDCETHER=y
CONFIG_USB_NET_CDC_NCM=y
CONFIG_USB_NET_CDC_SUBSET=y
CONFIG_USB_NET_CDC_SUBSET_ENABLE=y
CONFIG_USB_NET_NET1080=y
CONFIG_USB_NET_ZAURUS=y
CONFIG_USB_USBNET=y
# CONFIG_MTK_USB_TYPEC_U3_MUX_V2 is not set
# CONFIG_SMB1351_USB_CHARGER is not set
CONFIG_TYPEC=y

# ---- 调试 / 构建 ----
# CONFIG_HAVE_KPROBES is not set
# CONFIG_KPROBES is not set
# CONFIG_KPROBE_EVENTS is not set
# CONFIG_PANIC_ON_OOPS is not set
CONFIG_DEBUG_KINFO=y
# 关闭 LTO / CFI：MODVERSIONS 的 __crc_* 符号在 ThinLTO 下产生
# R_AARCH64_ABS32 重定位冲突（ld.lld: cannot be used against symbol
# __crc_xxx; recompile with -fPIC），且 fpsgo_v3（A12 版）与内核 LTO
# 符号解析冲突。与 bomb_user_defconfig 保持一致的组合。
CONFIG_MODVERSIONS=y
# CONFIG_CFI_CLANG_SHADOW is not set
# CONFIG_CFI_CLANG is not set
# CONFIG_CFI_PERMISSIVE is not set
# CONFIG_DEBUG_FS is not set
CONFIG_DEFAULT_SECURITY="selinux"
# CONFIG_INIT_STACK_ALL is not set
CONFIG_LOCALVERSION_AUTO=y
CONFIG_LOCALVERSION="-perf"
CONFIG_LOG_BUF_SHIFT=21
CONFIG_LTO_NONE=y
# CONFIG_LTO_CLANG is not set
CONFIG_SECURITY_SELINUX_BOOTPARAM_VALUE=1
# CONFIG_THINLTO is not set

# ---- TEE / 安全 ----
CONFIG_TEE=y
CONFIG_MICROTRUST_TEE_VERSION="400"

# ---- 其它 ----
CONFIG_MTK_VOLUP_LONG_PRESS_PANIC=y
CONFIG_BUILD_ARM64_APPENDED_DTB_IMAGE_NAMES="mediatek/atom"
# CONFIG_CANNONG_NFC is not set
# CONFIG_COMMON_CLK_MT6781 is not set
CONFIG_CUSTOM_KERNEL_BAROMETER=y
# CONFIG_CUSTOM_KERNEL_FREQ_BUMP_UP_SUPPORT is not set
# CONFIG_DECNET is not set
# CONFIG_DRM_MXSFB is not set
# CONFIG_DRM_PANEL_J22_43_03_0C_VDO is not set
# CONFIG_DRM_PANEL_JDI_NT36672C_CPHY_VDO_90HZ_RT4801_HFP is not set
# CONFIG_DRM_PANEL_JDI_NT36672C_CPHY_VDO_90HZ_RT4801 is not set
# CONFIG_DRM_PANEL_TIANMA_NT36672C_CPHY_VDO_90HZ_RT4801_HFP is not set
# CONFIG_DRM_PANEL_TIANMA_NT36672C_CPHY_VDO_90HZ_RT4801 is not set
# CONFIG_DRM_PANEL_TIANMA_NT36672E_VDO_120HZ_HFP is not set
# CONFIG_DRM_PANEL_TIANMA_NT36672E_VDO_120HZ_VFP is not set
# CONFIG_DRM_PANEL_TRULY_ILI9882N_VDO_90HZ is not set
# CONFIG_DRM_RT4831A_I2C is not set
CONFIG_IR_JVC_DECODER=y
CONFIG_IR_MCE_KBD_DECODER=y
CONFIG_IR_NEC_DECODER=y
CONFIG_IR_RC5_DECODER=y
CONFIG_IR_RC6_DECODER=y
CONFIG_IR_SANYO_DECODER=y
CONFIG_IR_SHARP_DECODER=y
CONFIG_IR_SONY_DECODER=y
CONFIG_IR_XMP_DECODER=y
# CONFIG_LED_MT6853 is not set
# CONFIG_LEDS_MTK_I2C is not set
# CONFIG_LIRC is not set
# CONFIG_MACH_MT6781 is not set
# CONFIG_MACH_MT6877 is not set
# CONFIG_MEDIATEK_CQDMA is not set
# CONFIG_MFD_TI_AM335X_TSCADC is not set
# CONFIG_MTD is not set
# CONFIG_MTK_BMA2XX is not set
# CONFIG_MTK_CAMERA_ISP_PDA_SUPPORT is not set
# CONFIG_MTK_COMBO_CHIP_CONSYS_6781 is not set
# CONFIG_MTK_COMBO_CHIP_CONSYS_6877 is not set
# CONFIG_MTK_CORE_CTL is not set
# CONFIG_MTK_DEVMPU_AEE is not set
# CONFIG_MTK_DEVMPU_SLOG is not set
CONFIG_MTK_DRM_KEY_MNG_SUPPORT=y
# CONFIG_MTK_DVFSRC_MT6781_PRETEST is not set
# CONFIG_MTK_DVFSRC_MT6877_PRETEST is not set
# CONFIG_MTK_DX_HDCP_DDP_SUPPORT is not set
# CONFIG_MTK_GATE_IC is not set
CONFIG_MTK_GPU_OPP_STATS_SUPPORT=y
CONFIG_MTK_HDR_COLOR_GAIN_RGB=0
# CONFIG_MTK_LPM_GS_DUMP_SUPPORT is not set
CONFIG_MTK_LPM_GS_DUMP_VERSION="v1"
# CONFIG_MTK_LPM_MT6781 is not set
# CONFIG_MTK_LPM_MT6877 is not set
CONFIG_MTK_MD1_SUPPORT=24
# CONFIG_MTK_MT6382_BDG is not set
# CONFIG_MTK_MT6382_CMD_MODE is not set
# CONFIG_MTK_MT6382_VDO_MODE is not set
# CONFIG_MTK_PMSR is not set
# CONFIG_MTK_SDA is not set
# CONFIG_MTK_SENSORHUB is not set
# CONFIG_MTK_STK3X1X_NEW is not set
CONFIG_MTK_SVP_ON_MTEE_SUPPORT=y
CONFIG_MTK_TINYSYS_SSPM_VERSION=""
# CONFIG_MTK_ULTRASND_PROXIMITY is not set
# CONFIG_MTK_VDEC_FMT is not set
# CONFIG_MTK_VIBRATOR is not set
CONFIG_MTK_VOW_DSP_VERSION="ver02"
# CONFIG_NET_CLS_RSVP6 is not set
# CONFIG_NET_CLS_RSVP is not set
# CONFIG_NET_CLS_TCINDEX is not set
# CONFIG_NET_SCH_CBQ is not set
# CONFIG_NET_SCH_DSMARK is not set
# CONFIG_NVM is not set
# CONFIG_PHY_MTK_FPGAPHY is not set
CONFIG_RC_CORE=y
CONFIG_RC_DECODERS=y
# CONFIG_RC_DEVICES is not set
CONFIG_RC_MAP=y
# CONFIG_REGULATOR_MT6317 is not set
# CONFIG_REGULATOR_RT5133 is not set
# CONFIG_RT4831A_I2C is not set
# CONFIG_SND_RICHTEK_SPM is not set
# CONFIG_SND_SOC_AS33970 is not set
# CONFIG_SND_SOC_MT6781 is not set
# CONFIG_SND_SOC_MT6781_MT6366 is not set
# CONFIG_SND_SOC_MT6877 is not set
# CONFIG_SND_SOC_MT6877_MT6359 is not set
# CONFIG_SND_SOC_RT5512 is not set
# CONFIG_SND_SOC_SMARTPAINFO is not set
# CONFIG_TOUCH_FW_MP_ONE is not set
# CONFIG_TOUCHSCREEN_HIMAX_CHIPSET_8789P1_8185P3 is not set
CONFIG_VIDEO_IR_I2C=y
```
